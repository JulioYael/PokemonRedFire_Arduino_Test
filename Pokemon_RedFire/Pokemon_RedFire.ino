#include <Adafruit_TFTLCD.h>
#include <Adafruit_GFX.h>

#define LCD_RESET A4
#define LCD_CS A3
#define LCD_CD A2
#define LCD_WR A1
#define LCD_RD A0

//Colores------------->

#define	Negro 0x0000
#define Blanco 0xFFFF
#define Azul 0x758efb
#define Prueba 0xF26A

Adafruit_TFTLCD tft(LCD_CS, LCD_CD, LCD_WR, LCD_RD, LCD_RESET);


void setup(){
    tft.reset();
    tft.begin(tft.readID());
    tft.setRotation(135); //Rotacion de la pantalla
    tft.fillScreen(Blanco);
    tft.setTextColor(Negro); 
	Serial.begin(9600);
	
}

// 'hierva', 20x20px
const unsigned char hierva [] PROGMEM = {
	0x00, 0x00, 0x00, 0x00, 0xe0, 0x00, 0x01, 0xa0, 0x00, 0x79, 0x13, 0x80, 0x47, 0x1e, 0x80, 0x63, 
	0x98, 0x80, 0x30, 0xd1, 0x80, 0x10, 0x61, 0x00, 0xd8, 0x21, 0x70, 0xbc, 0x23, 0xd0, 0x9f, 0xbc, 
	0x30, 0x80, 0xb0, 0x40, 0xc3, 0xff, 0xc0, 0x6e, 0x43, 0x00, 0x38, 0x41, 0x00, 0x10, 0xc1, 0x00, 
	0x31, 0xe1, 0x80, 0x63, 0x30, 0x40, 0x3c, 0x1f, 0x80, 0x00, 0x00, 0x00
};
// 'Piso', 20x20px
const unsigned char Piso [] PROGMEM = {
	0xff, 0xff, 0xf0, 0x80, 0x00, 0x10, 0x80, 0x00, 0x10, 0x80, 0x00, 0x10, 0x80, 0x00, 0x10, 0x80, 
	0x00, 0x10, 0x80, 0x00, 0x10, 0x80, 0x00, 0x10, 0x80, 0x00, 0x10, 0x80, 0x00, 0x10, 0x80, 0x00, 
	0x10, 0x80, 0x00, 0x10, 0x80, 0x00, 0x10, 0x80, 0x00, 0x10, 0x80, 0x00, 0x10, 0x80, 0x00, 0x10, 
	0x80, 0x00, 0x10, 0x80, 0x00, 0x10, 0x80, 0x00, 0x10, 0xff, 0xff, 0xf0
};
// '001', 90x84px
const unsigned char Bulb [] PROGMEM = {
	0x00, 0x00, 0x0c, 0x7e, 0x00, 0x00, 0x00, 0x00, 0x00, 0x00, 0x00, 0x00, 0x00, 0x00, 0x0c, 0x7e, 
	0x00, 0x00, 0x00, 0x00, 0x00, 0x00, 0x00, 0x00, 0x00, 0x00, 0x0c, 0x7e, 0x00, 0x00, 0x00, 0x00, 
	0x00, 0x00, 0x00, 0x00, 0x00, 0x00, 0x73, 0x81, 0xc0, 0x00, 0x00, 0x00, 0x00, 0x00, 0x00, 0x00, 
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	0x00, 0x00, 0x00, 0x00, 0x00, 0x00, 0x00, 0x00, 0x00, 0x07, 0xff, 0xfc, 0x00, 0x00, 0x00, 0x00
};
// '004', 64x70px
const unsigned char Charm [] PROGMEM = {
	0x00, 0x01, 0xff, 0x00, 0x00, 0x00, 0x00, 0x00, 0x00, 0x01, 0xff, 0x00, 0x00, 0x00, 0x00, 0x00, 
	0x00, 0x0e, 0x00, 0xe0, 0x00, 0x00, 0x00, 0x00, 0x00, 0x30, 0x00, 0x18, 0x00, 0x00, 0x00, 0x00, 
	0x00, 0x30, 0x00, 0x18, 0x00, 0x00, 0x00, 0x00, 0x00, 0xc0, 0x00, 0x18, 0x00, 0x00, 0x00, 0x00, 
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	0x00, 0x3f, 0x80, 0x00, 0xc0, 0x30, 0x00, 0x00, 0x00, 0x3f, 0x80, 0x00, 0xc0, 0x30, 0x00, 0x00
};
// 'EA', 140x100px
const unsigned char EA [] PROGMEM = {
	0x3f, 0xff, 0xff, 0xff, 0xff, 0xff, 0xff, 0xff, 0xff, 0xff, 0xff, 0xff, 0xff, 0xff, 0xff, 0xff, 
	0xff, 0xc0, 0x40, 0x00, 0x00, 0x00, 0x00, 0x00, 0x00, 0x00, 0x00, 0x00, 0x00, 0x00, 0x00, 0x00, 
	0x00, 0x00, 0x00, 0x20, 0x8f, 0xff, 0xff, 0xff, 0xff, 0xff, 0xff, 0xff, 0xff, 0xff, 0xff, 0xff, 
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	0x7f, 0x00, 0x00, 0x00, 0x00, 0x00, 0x7f, 0x80
};
// 'Cafeteria', 120x60px
const unsigned char Cafeteria [] PROGMEM = {
	0x00, 0x00, 0x00, 0x00, 0x00, 0x00, 0x00, 0x00, 0x00, 0x00, 0x00, 0x00, 0x00, 0x00, 0x00, 0x00, 
	0x00, 0x00, 0x00, 0x00, 0x00, 0x00, 0x00, 0x00, 0x00, 0x00, 0x00, 0x00, 0x00, 0x00, 0x00, 0x00, 
	0x00, 0x00, 0x00, 0x00, 0x00, 0x00, 0x00, 0x00, 0x00, 0x00, 0x00, 0x00, 0x00, 0x00, 0x00, 0x00, 
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	0x00, 0x00, 0x50, 0x00
};
// 'LabElec', 320x240px
const unsigned char LabElect [] PROGMEM = {
	0x00, 0x00, 0x00, 0x00, 0x00, 0x00, 0x00, 0x00, 0x00, 0x00, 0x00, 0x00, 0x00, 0x00, 0x00, 0x00, 
	0x00, 0x00, 0x08, 0x80, 0x00, 0x00, 0x00, 0x00, 0x00, 0x00, 0x00, 0x22, 0x00, 0x00, 0x00, 0x00, 
	0x00, 0x00, 0x00, 0x00, 0x00, 0x00, 0x00, 0x00, 0x00, 0x00, 0x00, 0x00, 0x00, 0x00, 0x00, 0x00, 
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	0xff, 0xff, 0xff, 0xff, 0xff, 0xff, 0xff, 0xff, 0xff, 0xff, 0xff, 0xff, 0xff, 0xff, 0xff, 0xff
};


void loop(){
	
	
	Mapa_1();
	delay(1500);
    Inicio_Combate();
    Seleccion_Enemigo();
    Seleccion_Aliado();
    delay(1500);
    Menu_Combate();
    delay(1500);
    Menu_Ataques();
    delay(1500);
	Ataque_Aliado();
	Menu_Combate();
	delay(3000);
   	
    
   
}

void Mapa_1(){
	tft.drawBitmap(5,50, Cafeteria, 120, 60, Negro);
    tft.drawBitmap(130, 10, EA, 140, 100, Negro);
    for(int j = 0; j<= 80; j = j + 20){
        for(int i = 0; i <= 160; i = i+20){
            if(i == 80){
                tft.drawBitmap(110+i, 110+j, Piso, 20, 20, Negro);
            }
            if(j <= 20 && i != 80){
                tft.drawBitmap(110+i, 110+j, hierva, 20, 20, Negro);
            }
            if(j>=40){
                tft.drawBitmap(110+i, 110+j, Piso, 20, 20, Negro);
            }
        }
    }
}
void display_grid(){
    for(int i = 10; i<= 320; i = i+20){
        tft.drawLine(i, 0, i, 240, Negro);
        tft.drawLine(0, i, 320, i, Negro);
        //tft.drawBitmap(i, i, hierva, 20, 20, Negro);
    };
}
void inicio(){
    tft.fillScreen(Blanco);
    tft.setCursor(100, 20);
    tft.setTextSize(3);
    tft.println("Poke-Tec"); 

    tft.setCursor(140,60);
    tft.setTextSize(2);
    tft.println("ITSX");

    for (int i =0; i < 2; i++){     
        tft.setCursor(40, 180);
        tft.setTextSize(2);
        tft.println("toque para continuar.");
        delay(800);
        tft.fillRect(40, 180, 250, 20, Blanco);
        delay(500);
    }
    
}
void Inicio_Combate(){
    for(int y = 0; y <= 240; y = y+60){
        tft.fillTriangle(0, 0, 70, 0, 0, y, Negro );
    }
    for(int y = 240; y >= 150; y = y-60){
        tft.fillTriangle(150, 240, 320, 240, 320, y, Negro );
    }
    for(int x = 340; x >= 40; x = x-60){
        tft.fillTriangle(320, 130, 320, 0, x, 0, Negro );
    }
    for(int x = 130; x <= 240; x = x+60){
        tft.fillTriangle(0, 130, 0, 240, x, 240, Negro );
    }
    for(int y = 240; y >= 0; y = y-60){
        tft.fillTriangle(200, 240, 400, 240, 340 , y, Negro );
    }
    for(int d = 0; d <= 240; d = d +60){
        tft.fillTriangle(70, 0, 10, d, d, d, Negro);
    }
    tft.setRotation(45);
    tft.fillScreen(Negro);
    tft.setRotation(135);
    tft.fillScreen(Blanco);

    //Contenedor de texto
    tft.fillRoundRect(0, 170, 5, 75, 10, Negro);
    tft.fillRoundRect(0, 170, 320, 5, 3, Negro);
    tft.fillRoundRect(315, 170, 5, 75, 3, Negro);
    tft.fillRoundRect(0, 235, 320, 5, 3, Negro);
    tft.fillRect(5, 175, 310, 60, Blanco);    
    delay(1500);
}
void Seleccion_Enemigo(){
    tft.setTextSize(2);
    tft.setCursor(15, 185);
    tft.println("A luchar contra");
    tft.setCursor(15, 205);
    tft.println("RIVAL Gary");
    delay(1500);

    tft.fillRect(5, 175, 310, 60, Blanco);  
    tft.setTextSize(2);
    tft.setCursor(15, 185);
    tft.println("CHARMANDER es el POKEMON");
    tft.setCursor(15, 205);
    tft.println("enviado por RIVAL Gary");
    delay(1500);

    for(int x =0; x <= 150; x++){
        tft.drawRect(-145+x,5,145, 40, Negro);
        tft.fillRect(-144+x,6,143,38, Blanco);
        tft.drawLine(-146+x, 5, -146+x, 46, Blanco);
    }

    //Pokemon enemigo
    tft.drawRect(5,5,145, 40, Negro);//Box Pokemon estatus
    tft.setTextSize(1);
    tft.setCursor(10, 10);
    tft.print("CHARMANDER"); //Nombre
    tft.setCursor(125, 10);
    tft.print("Nv5");//nivel
    tft.fillRoundRect(55,23, 90, 11,10, Negro);//Vida
    tft.setCursor(38, 25);
    tft.print("PS");//indicador de PS
    tft.setCursor(115, 36);
    tft.print("20/20");//Numero de PS
    tft.drawRoundRect(30, 23, 40, 11,10, Negro);//Contenedor de PS
    //Posicion y medida pokemon enemigo
    tft.drawBitmap(210, 20, Charm, 64, 70, Negro);
}
void Seleccion_Aliado(){
    tft.fillRect(5, 175, 310, 60, Blanco);
    tft.setTextSize(2);
    tft.setCursor(15, 185);
    tft.println("Adelante, BULBASAUR");
    delay(500);

    for(int x =0; x <= 150; x++){
        tft.drawRect(320-x, 110,145, 55, Negro);//Box Pokemon estatus
        tft.fillRect(321-x, 111, 143, 53, Blanco);
        tft.drawLine(465-x, 110, 465-x, 165, Blanco);
    }

    //Pokemon aliado
    tft.setTextSize(1);
    tft.drawRect(170,110,145, 55, Negro);//Box Pokemon estatus
    tft.setCursor(175, 115);
    tft.print("BULBASAUR");//Nombre
    tft.setCursor(287,115);
    tft.print("Nv5");//nivel
    tft.setCursor(202, 132);
    tft.print("PS");//indicador de PS
    tft.fillRoundRect(220 ,130, 90, 11, 10, Negro);//Vida
    tft.drawRoundRect(197, 130, 40, 11,10, Negro);//Contenedor de PS
    tft.setCursor(275, 143);//133
    tft.print("20/20");//Numero de PS
    //Posicion y medida pokemon aliado
    tft.drawBitmap(40, 86, Bulb, 90, 84, Negro);
    tft.setCursor(180, 152);
    tft.print("EXP");
    tft.drawRect(200, 153, 110, 5, Negro);//Contenedor de EXP
    tft.endWrite();
}
void Menu_Combate(){
    //Contenedor de menu
    tft.fillRoundRect(0, 170, 5, 75, 10, Negro);
    tft.fillRoundRect(0, 170, 320, 5, 3, Negro);
    tft.fillRoundRect(315, 170, 5, 75, 3, Negro);
    tft.fillRoundRect(0, 235, 320, 5, 3, Negro);
    tft.fillRect(5, 175, 310, 85, Blanco);

    //Texto menu
    tft.setTextSize(2);
    tft.setCursor(10, 185);
    tft.print("Que deberia");
    tft.setCursor(40, 205); 
    tft.print("hacer?");  

    tft.drawLine(145, 170 ,145, 240, Negro);//division

    //Menu de acciones
    tft.setTextSize(1);
    tft.setCursor(166,193);
    tft.print("Lucha");
    tft.setCursor(248, 193);
    tft.print("Mochila");
    tft.setCursor(166, 213);
    tft.print("Pokemon");
    tft.setCursor(248, 213);
    tft.print("Huir");

    tft.fillTriangle(155, 191, 155, 201, 160, 196, Negro); //Selector de opciones
    tft.endWrite();
}
void Menu_Ataques(){
    //Contenedor de menu
    tft.fillRoundRect(0, 170, 5, 75, 10, Negro);
    tft.fillRoundRect(0, 170, 320, 5, 3, Negro);
    tft.fillRoundRect(315, 170, 5, 75, 3, Negro);
    tft.fillRoundRect(0, 235, 320, 5, 3, Negro);
    tft.fillRect(5, 175, 310, 85, Blanco);
    //Ataques menu
    tft.setTextSize(1);
    tft.setCursor(36-10,188);
    tft.print("PLACAJE");
    tft.setCursor(128-10, 188);
    tft.print("GRUNIDO");
    tft.setCursor(36-10, 213);
    tft.print("   -   ");
    tft.setCursor(128-10, 213);
    tft.print("   -   ");

    tft.fillTriangle(26-10, 186, 26-10, 196, 31-10, 191, Negro);//Selector de opciones
    tft.drawLine(180, 170 ,180, 240, Negro);//division
    
    //Contador de PP
    tft.setTextSize(2);
    tft.setCursor(185, 180);
    tft.print("PP");
    tft.setCursor(250, 180);
    tft.print("35/35");
    tft.setCursor(185, 220);
    tft.print("TIPO/NORMAL");
    tft.endWrite();
}

void Ataque_Aliado(){
	tft.fillRect(5, 175, 310, 85, Blanco);
	 tft.setTextSize(2);
    tft.setCursor(10, 185);
	tft.println("Bulbasaur uso");
	tft.setCursor(10, 205);
	tft.print("PLACAJE!");
	delay(1000);
	for(int i = 0; i <= 2; i++){
		tft.fillRect(210, 20, 64, 70, Blanco);
		tft.drawBitmap(210, 20, Charm, 64, 70, Negro);
	}
}
